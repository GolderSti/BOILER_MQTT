## main/Kconfig.projbuild
```kconfig
menu "WiFi Configuration"

    config ESP_WIFI_SSID
        string "WiFi SSID"
        default "Sti-WiFi"
        help
            SSID (network name) for the example to connect to.

    config ESP_WIFI_PASSWORD
        string "WiFi Password"
        default "6k8wSbcN"
        help
            WiFi password (WPA or WPA2) for the example to use.
endmenu
menu "MQTT Configuration"

    config BROKER_URL
        string "Broker URL"
        default "mqtt://GolderSti:tg5g5tg@192.168.2.56"
        help
            URL of the broker to connect to

    config BROKER_URL_FROM_STDIN
        bool
        default y if BROKER_URL = "FROM_STDIN"

endmenu
```
